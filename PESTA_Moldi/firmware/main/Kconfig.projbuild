## PESTA_Moldi/firmware/main/Kconfig.projbuild
```kconfig
menu "ESP32 Gateway configuration"

config WIFI_SSID
    string "Wi-Fi SSID"
    default "YOUR_WIFI_SSID"

config WIFI_PASSWORD
    string "Wi-Fi Password"
    default "YOUR_WIFI_PASSWORD"

config API_URL
    string "Readings API URL"
    default "http://192.168.1.100:3000/api/readings"

config DEVICE_ID
    string "Device identifier"
    default "esp32-gateway-01"

config SEND_INTERVAL_SECONDS
    int "Send interval in seconds"
    default 10
    range 1 3600

config HTTP_TIMEOUT_MS
    int "HTTP timeout (ms)"
    default 5000
    range 500 60000

endmenu
```

## PESTA_Moldi/firmware/sdkconfig.defaults
```kconfig
CONFIG_ESP_WIFI_STA_DISCONNECTED_PM_ENABLE=n
CONFIG_WIFI_SSID="YOUR_WIFI_SSID"
CONFIG_WIFI_PASSWORD="YOUR_WIFI_PASSWORD"
CONFIG_API_URL="http://192.168.1.100:3000/api/readings"
CONFIG_DEVICE_ID="esp32-gateway-01"
CONFIG_SEND_INTERVAL_SECONDS=10
CONFIG_HTTP_TIMEOUT_MS=5000
```
